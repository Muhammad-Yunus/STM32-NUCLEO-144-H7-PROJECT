/**
 ******************************************************************************
 * @file    gui.c
 * @brief   Basic 2-D GUI primitives adapted from Adafruit GFX style.
 *          Provides drawing, text rendering and minimal animation helpers.
 *
 * Key design decisions (Adafruit GFX inspired):
 *   • GUI_DrawPixel() is the core – all drawing primitives call it
 *   • Global GUI state (cursor, text color/size) similar to Adafruit GFX
 *   • Fast implementations for lines/rects avoid per-pixel iteration
 *   • Font is 8×16 monochrome, scaled by GUI_TEXTSIZE
 *   • No dynamic allocation – fits embedded use case
 ******************************************************************************
 */

#include "gui.h"
#include <stdlib.h>
#include <stdio.h>
#include <string.h>

/* ═══════════════════════════════════════════════════════════════════════════
 *  GUI State (Adafruit GFX style globals)
 * ═══════════════════════════════════════════════════════════════════════════ */

uint16_t GUI_TEXTCOLOR = BLACK;
uint16_t GUI_BGCOLOR   = WHITE;
uint8_t  GUI_TEXTSIZE  = 1;
uint16_t GUI_CURSOR_X  = 0;
uint16_t GUI_CURSOR_Y  = 0;

/* ═══════════════════════════════════════════════════════════════════════════
 *  Font (8×16, same as before)
 * ═══════════════════════════════════════════════════════════════════════════ */
const uint8_t asc2_1608[95][16] =
{
    {0x00,0x00,0x00,0x00,0x00,0x00,0x00,0x00,0x00,0x00,0x00,0x00,0x00,0x00,0x00,0x00},/*" ",0*/
    {0x00,0x00,0x04,0x04,0x04,0x04,0x04,0x04,0x04,0x00,0x00,0x04,0x00,0x00,0x00,0x00},/*"!",1*/
    {0x14,0x14,0x14,0x00,0x00,0x00,0x00,0x00,0x00,0x00,0x00,0x00,0x00,0x00,0x00,0x00},/*'"',2*/
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    {0x00,0x00,0x00,0x00,0x00,0x09,0x16,0x00,0x00,0x00,0x00,0x00,0x00,0x00,0x00,0x00},/*"~",94*/
};

/* ═══════════════════════════════════════════════════════════════════════════
 *  Core: single pixel draw
 * ═══════════════════════════════════════════════════════════════════════════ */

void GUI_DrawPixel(uint16_t x, uint16_t y, uint16_t color)
{
    if (x >= lcddev.width || y >= lcddev.height) return;
    LCD_DrawPoint(x, y);
}

/* ═══════════════════════════════════════════════════════════════════════════
 *  Fast lines (Adafruit GFX style)
 * ═══════════════════════════════════════════════════════════════════════════ */

void GUI_DrawFastVLine(uint16_t x, uint16_t y, uint16_t h, uint16_t color)
{
    if (h == 0) return;
    if (x >= lcddev.width || y >= lcddev.height) return;
    if (y + h > lcddev.height) h = lcddev.height - y;

    LCD_SetWindows(x, y, x, y + h - 1);
    for (uint32_t i = 0; i < h; i++)
        LCD->LCD_RAM = color;
}

void GUI_DrawFastHLine(uint16_t x, uint16_t y, uint16_t w, uint16_t color)
{
    if (w == 0) return;
    if (x >= lcddev.width || y >= lcddev.height) return;
    if (x + w > lcddev.width) w = lcddev.width - x;

    LCD_SetWindows(x, y, x + w - 1, y);
    for (uint32_t i = 0; i < w; i++)
        LCD->LCD_RAM = color;
}

void GUI_DrawLine(uint16_t x1, uint16_t y1, uint16_t x2, uint16_t y2, uint16_t color)
{
    /* Optimized for vertical/horizontal lines */
    if (x1 == x2)
    {
        GUI_DrawFastVLine(x1, y1, (y2 > y1) ? y2 - y1 + 1 : y1 - y2 + 1, color);
        return;
    }
    if (y1 == y2)
    {
        GUI_DrawFastHLine(x1, y1, (x2 > x1) ? x2 - x1 + 1 : x1 - x2 + 1, color);
        return;
    }

    /* General Bresenham line */
    int16_t steep = (abs(y2 - y1) > abs(x2 - x1)) ? 1 : 0;
    if (steep)
    {
        int16_t t = x1; x1 = y1; y1 = t;
        t = x2; x2 = y2; y2 = t;
    }
    if (x1 > x2)
    {
        int16_t t = x1; x1 = x2; x2 = t;
        t = y1; y1 = y2; y2 = t;
    }

    int16_t dx = x2 - x1;
    int16_t dy = abs(y2 - y1);
    int16_t err = dx / 2;
    int16_t ystep = (y1 < y2) ? 1 : -1;

    for (; x1 <= x2; x1++)
    {
        if (steep) GUI_DrawPixel(y1, x1, color);
        else       GUI_DrawPixel(x1, y1, color);
        err -= dy;
        if (err < 0) { y1 += ystep; err += dx; }
    }
}

/* ═══════════════════════════════════════════════════════════════════════════
 *  Rectangles (Adafruit GFX style)
 * ═══════════════════════════════════════════════════════════════════════════ */

void GUI_DrawRect(uint16_t x, uint16_t y, uint16_t w, uint16_t h, uint16_t color)
{
    GUI_DrawFastHLine(x, y, w, color);
    GUI_DrawFastHLine(x, y + h - 1, w, color);
    GUI_DrawFastVLine(x, y, h, color);
    GUI_DrawFastVLine(x + w - 1, y, h, color);
}

void GUI_FillRect(uint16_t x, uint16_t y, uint16_t w, uint16_t h, uint16_t color)
{
    if (w == 0 || h == 0) return;
    if (x >= lcddev.width || y >= lcddev.height) return;
    if (x + w > lcddev.width) w = lcddev.width - x;
    if (y + h > lcddev.height) h = lcddev.height - y;

    LCD_SetWindows(x, y, x + w - 1, y + h - 1);
    for (uint32_t i = 0; i < (uint32_t)w * h; i++)
        LCD->LCD_RAM = color;
}

void GUI_DrawRectangle(uint16_t x1, uint16_t y1, uint16_t x2, uint16_t y2, uint16_t color)
{
    GUI_DrawRect(x1, y1, x2 - x1 + 1, y2 - y1 + 1, color);
}

void GUI_Fill(uint16_t sx, uint16_t sy, uint16_t ex, uint16_t ey, uint16_t color)
{
    GUI_FillRect(sx, sy, ex - sx + 1, ey - sy + 1, color);
}

/* ═══════════════════════════════════════════════════════════════════════════
 *  Circles (Adafruit GFX style)
 * ═══════════════════════════════════════════════════════════════════════════ */

void GUI_DrawCircle(uint16_t x0, uint16_t y0, uint8_t r, uint16_t color)
{
    int16_t f = 1 - r;
    int16_t ddF_x = 1;
    int16_t ddF_y = -2 * r;
    int16_t x = 0;
    int16_t y = r;

    GUI_DrawPixel(x0, y0 + r, color);
    GUI_DrawPixel(x0, y0 - r, color);
    GUI_DrawPixel(x0 + r, y0, color);
    GUI_DrawPixel(x0 - r, y0, color);

    while (x < y)
    {
        if (f >= 0) { y--; ddF_y += 2; f += ddF_y; }
        x++; ddF_x += 2; f += ddF_x;

        GUI_DrawPixel(x0 + x, y0 + y, color);
        GUI_DrawPixel(x0 - x, y0 + y, color);
        GUI_DrawPixel(x0 + x, y0 - y, color);
        GUI_DrawPixel(x0 - x, y0 - y, color);
        GUI_DrawPixel(x0 + y, y0 + x, color);
        GUI_DrawPixel(x0 - y, y0 + x, color);
        GUI_DrawPixel(x0 + y, y0 - x, color);
        GUI_DrawPixel(x0 - y, y0 - x, color);
    }
}

/* Helper for filled circle (midpoint circle algorithm) */
static void GUI_FillCircle_Helper(uint16_t x0, uint16_t y0, uint8_t r, uint8_t cornername, uint16_t color)
{
    int16_t f = 1 - r;
    int16_t ddF_x = 1;
    int16_t ddF_y = -2 * r;
    int16_t x = 0;
    int16_t y = r;

    while (x < y)
    {
        if (f >= 0) { y--; ddF_y += 2; f += ddF_y; }
        x++; ddF_x += 2; f += ddF_x;

        if (cornername & 0x01) GUI_DrawFastVLine(x0 + x, y0 - y, 2 * y + 1, color);
        if (cornername & 0x02) GUI_DrawFastVLine(x0 - x, y0 - y, 2 * y + 1, color);
        if (cornername & 0x04) GUI_DrawFastVLine(x0 + y, y0 - x, 2 * x + 1, color);
        if (cornername & 0x08) GUI_DrawFastVLine(x0 - y, y0 - x, 2 * x + 1, color);
    }
}

void GUI_FillCircle(uint16_t x0, uint16_t y0, uint8_t r, uint16_t color)
{
    GUI_DrawFastVLine(x0, y0 - r, 2 * r + 1, color);
    GUI_FillCircle_Helper(x0, y0, r, 0x0F, color);
}

/* ═══════════════════════════════════════════════════════════════════════════
 *  Rounded rectangles
 * ═══════════════════════════════════════════════════════════════════════════ */

void GUI_DrawRoundRect(uint16_t x, uint16_t y, uint16_t w, uint16_t h, uint8_t r, uint16_t color)
{
    if (w < 2 || h < 2 || r > w / 2 || r > h / 2) return;

    GUI_DrawFastHLine(x + r, y, w - 2 * r, color);
    GUI_DrawFastHLine(x + r, y + h - 1, w - 2 * r, color);
    GUI_DrawFastVLine(x, y + r, h - 2 * r, color);
    GUI_DrawFastVLine(x + w - 1, y + r, h - 2 * r, color);

    GUI_DrawCircle(x + r, y + r, r, color);
    GUI_DrawCircle(x + w - r - 1, y + r, r, color);
    GUI_DrawCircle(x + r, y + h - r - 1, r, color);
    GUI_DrawCircle(x + w - r - 1, y + h - r - 1, r, color);
}

void GUI_FillRoundRect(uint16_t x, uint16_t y, uint16_t w, uint16_t h, uint8_t r, uint16_t color)
{
    if (w < 2 || h < 2 || r > w / 2 || r > h / 2) return;

    GUI_FillRect(x + r, y, w - 2 * r, h, color);
    GUI_FillCircle_Helper(x + r, y + r, r, 1, color);
    GUI_FillCircle_Helper(x + w - r - 1, y + r, r, 2, color);
    GUI_FillCircle_Helper(x + r, y + h - r - 1, r, 4, color);
    GUI_FillCircle_Helper(x + w - r - 1, y + h - r - 1, r, 8, color);
}

/* ═══════════════════════════════════════════════════════════════════════════
 *  Triangles (optional, Adafruit GFX style)
 * ═══════════════════════════════════════════════════════════════════════════ */

void GUI_DrawTriangle(uint16_t x0, uint16_t y0, uint16_t x1, uint16_t y1,
                       uint16_t x2, uint16_t y2, uint16_t color)
{
    GUI_DrawLine(x0, y0, x1, y1, color);
    GUI_DrawLine(x1, y1, x2, y2, color);
    GUI_DrawLine(x2, y2, x0, y0, color);
}

void GUI_FillTriangle(uint16_t x0, uint16_t y0, uint16_t x1, uint16_t y1,
                      uint16_t x2, uint16_t y2, uint16_t color)
{
    int16_t a, b, y, tmp;

    if (y0 > y1) { tmp = y0; y0 = y1; y1 = tmp; tmp = x0; x0 = x1; x1 = tmp; }
    if (y0 > y2) { tmp = y0; y0 = y2; y2 = y1; y1 = tmp; tmp = x0; x0 = x2; x2 = tmp; }
    if (y1 > y2) { tmp = y1; y1 = y2; y2 = tmp; tmp = x1; x1 = x2; x2 = tmp; }

    a = b = 0;
    for (y = y0; y <= y2; y++)
    {
        if (y < y1) a = (y - y0) * (x2 - x0) / (y2 - y0) + x0;
        else        a = (y - y1) * (x2 - x1) / (y2 - y1) + x1;

        if (y < y1) b = (y - y0) * (x1 - x0) / (y1 - y0) + x0;
        else        b = (y - y1) * (x1 - x0) / (y1 - y0) + x0;

        if (a > b) { tmp = a; a = b; b = tmp; }
        GUI_DrawFastHLine(a, y, b - a + 1, color);
    }
}

/* ═══════════════════════════════════════════════════════════════════════════
 *  Text rendering (Adafruit GFX style)
 * ═══════════════════════════════════════════════════════════════════════════ */

void GUI_SetCursor(uint16_t x, uint16_t y)
{
    GUI_CURSOR_X = x;
    GUI_CURSOR_Y = y;
}

void GUI_SetTextColor(uint16_t fg, uint16_t bg)
{
    GUI_TEXTCOLOR = fg;
    GUI_BGCOLOR = bg;
}

void GUI_SetTextSize(uint8_t size)
{
    GUI_TEXTSIZE = (size > 0) ? size : 1;
}

void GUI_WriteChar(uint8_t c)
{
    uint8_t i, j;
    uint8_t size = GUI_TEXTSIZE;
    uint8_t width = 8 * size;     /* original width 8, scaled */
    uint8_t height = 16 * size;   /* original height 16, scaled */

    if (c < ' ' || c > '~') { c = ' '; }
    c -= ' ';

    /* Optimized character rendering - direct LCD RAM writes */
    uint16_t char_x = GUI_CURSOR_X;
    uint16_t char_y = GUI_CURSOR_Y;
    uint8_t w = 8 * size;
    uint8_t h = 16 * size;

    /* Set window once for entire character */
    LCD_SetWindows(char_x, char_y, char_x + w - 1, char_y + h - 1);

    for (i = 0; i < 16; i++)
    {
        uint8_t line = asc2_1608[c][i];
        for (uint8_t sy = 0; sy < size; sy++)  /* Vertical scaling */
        {
            uint8_t line_bits = line;
            for (j = 0; j < 8; j++)
            {
                uint16_t color = (line_bits & 0x01) ? GUI_TEXTCOLOR : GUI_BGCOLOR;
                /* Horizontal scaling - write 'size' pixels */
                for (uint8_t sx = 0; sx < size; sx++)
                {
                    LCD->LCD_RAM = color;
                }
                line_bits >>= 1;
            }
        }
    }

    /* Update cursor */
    GUI_CURSOR_X += width;
    if (GUI_CURSOR_X > lcddev.width - width)
    {
        GUI_CURSOR_X = 0;
        GUI_CURSOR_Y += height;
    }
    if (GUI_CURSOR_Y > lcddev.height - height)
        GUI_CURSOR_Y = 0;
}

void GUI_Print(const char *str)
{
    while (*str)
    {
        GUI_WriteChar(*str);
        str++;
    }
}

void GUI_Println(const char *str)
{
    GUI_Print(str);
    GUI_CURSOR_X = 0;
    GUI_CURSOR_Y += 16 * GUI_TEXTSIZE;
}

void GUI_PrintNum(int32_t num)
{
    char buf[12];
    snprintf(buf, sizeof(buf), "%ld", (long)num);
    GUI_Print(buf);
}

void GUI_PrintFloat(float num, uint8_t precision)
{
    char buf[20];
    snprintf(buf, sizeof(buf), "%.*f", precision, (double)num); // @suppress("Float formatting support")
    GUI_Print(buf);
}

/* ═══════════════════════════════════════════════════════════════════════════
 *  Compatibility wrappers (original API)
 * ═══════════════════════════════════════════════════════════════════════════ */

void GUI_ShowChar(uint16_t x, uint16_t y, uint8_t num,
                  uint16_t fc, uint16_t bc, uint8_t sizey, uint8_t mode)
{
    uint8_t old_fg = GUI_TEXTCOLOR;
    uint8_t old_bg = GUI_BGCOLOR;
    uint8_t old_size = GUI_TEXTSIZE;

    GUI_SetCursor(x, y);
    GUI_SetTextColor(fc, (mode == 0) ? bc : BACK_COLOR);
    GUI_SetTextSize(sizey / 8);   /* sizey is 16 for 8x16 font */

    GUI_WriteChar(num + 0x20);

    GUI_TEXTCOLOR = old_fg;
    GUI_BGCOLOR = old_bg;
    GUI_TEXTSIZE = old_size;
}

void GUI_ShowString(uint16_t x, uint16_t y, const uint8_t *p, uint16_t color)
{
    GUI_SetCursor(x, y);
    GUI_SetTextColor(color, GUI_BGCOLOR);
    while (*p)
    {
        GUI_WriteChar(*p);
        p++;
    }
}

void GUI_ShowNum(uint16_t x, uint16_t y, uint32_t num,
                 uint8_t len, uint16_t color)
{
    char buf[12];
    snprintf(buf, sizeof(buf), "%*lu", len, (unsigned long)num);
    GUI_ShowString(x, y, (const uint8_t *)buf, color);
}

void GUI_ShowIntNum(uint16_t x, uint16_t y, int32_t num,
                    uint8_t len, uint16_t color)
{
    char buf[14];
    snprintf(buf, sizeof(buf), "%*ld", len, (long)num);
    GUI_ShowString(x, y, (const uint8_t *)buf, color);
}

void GUI_ShowFloatNum(uint16_t x, uint16_t y, float num,
                      uint8_t precision, uint16_t color)
{
    char buf[20];
    snprintf(buf, sizeof(buf), "%.*f", precision, (double)num); // @suppress("Float formatting support")
    GUI_ShowString(x, y, (const uint8_t *)buf, color);
}
